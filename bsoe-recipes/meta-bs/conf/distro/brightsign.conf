## bsoe-recipes/meta-bs/conf/distro/brightsign.conf
```bitbake
# BrightSign Distribution Configuration

DISTRO = "brightsign"
DISTRO_NAME = "BrightSign"
DISTRO_VERSION = "9.1.52"
DISTRO_CODENAME = "dunfell"

MAINTAINER = "BrightSign LLC"

# Use systemd as init system
DISTRO_FEATURES_append = " systemd"
VIRTUAL-RUNTIME_init_manager = "systemd"
DISTRO_FEATURES_BACKFILL_CONSIDERED = "sysvinit"

# Base distro features
DISTRO_FEATURES_DEFAULT = "acl alsa argp bluetooth ext2 ipv4 ipv6 largefile pcmcia usbgadget usbhost wifi xattr nfs zeroconf pci 3g nfc vfat"

# SDK features
SDK_NAME = "${DISTRO}-${TCLIBC}-${SDK_ARCH}-${IMAGE_BASENAME}-${TUNE_PKGARCH}"
SDKPATH = "/opt/${DISTRO}/${SDK_VERSION}"

# GLIBC features
DISTRO_FEATURES_LIBC = "ipv4 ipv6 libc-backtrace libc-big-macros libc-bsd libc-cxx-tests libc-catgets libc-charsets libc-crypt \
                        libc-crypt-ufc libc-db-aliases libc-envz libc-fcvt libc-fmtmsg libc-fstab libc-ftraverse \
                        libc-getlogin libc-idn libc-inet-anl libc-libm libc-locales libc-locale-code \
                        libc-memusage libc-nis libc-nsswitch libc-rcmd libc-rtld-debug libc-spawn libc-streams libc-sunrpc \
                        libc-utmp libc-utmpx libc-wordexp libc-posix-clang-wchar libc-posix-regexp libc-posix-regexp-glibc \
                        libc-posix-wchar-io"

DISTRO_FEATURES = "${DISTRO_FEATURES_DEFAULT} ${DISTRO_FEATURES_LIBC}"

# Build settings
TCLIBC ?= "glibc"
TCLIBCAPPEND = ""

# Don't include meta-yocto-bsp
BBFILE_COLLECTIONS_remove = "yoctobsp"

# QA check settings
WARN_TO_ERROR_QA = "already-stripped compile-host-path install-host-path \
                    installed-vs-shipped ldflags pn-overrides rpaths staticdev \
                    unknown-configure-option useless-rpaths"
WARN_QA_remove = "${WARN_TO_ERROR_QA}"
ERROR_QA_append = " ${WARN_TO_ERROR_QA}"

# Package feed settings
PACKAGE_CLASSES ?= "package_ipk"

# Allow commercial licenses
LICENSE_FLAGS_WHITELIST = "commercial"

require conf/distro/include/yocto-uninative.inc
INHERIT += "uninative"
```

## bsoe-recipes/meta-bs/conf/layer.conf
```bitbake
# We have a conf and classes directory, add to BBPATH
BBPATH .= ":${LAYERDIR}"

# We have recipes-* directories, add to BBFILES
BBFILES += "${LAYERDIR}/recipes-*/*/*.bb \
            ${LAYERDIR}/recipes-*/*/*.bbappend"

BBFILE_COLLECTIONS += "meta-bs bs-layer"
BBFILE_PATTERN_meta-bs = "^${LAYERDIR}/"
BBFILE_PATTERN_bs-layer = "^${LAYERDIR}/"
BBFILE_PRIORITY_meta-bs = "10"
BBFILE_PRIORITY_bs-layer = "10"

LAYERDEPENDS_meta-bs = "core"
LAYERDEPENDS_bs-layer = "core"
LAYERSERIES_COMPAT_meta-bs = "dunfell"
LAYERSERIES_COMPAT_bs-layer = "dunfell"
```

## bsoe-recipes/meta-bs/conf/machine/cobra.conf
```bitbake
# Cobra (XT5/Firebird) Machine Configuration

#@TYPE: Machine
#@NAME: Cobra
#@DESCRIPTION: Machine configuration for BrightSign XT5/Firebird players

require conf/machine/include/arm/arch-arm64.inc

MACHINEOVERRIDES =. "cobra:"

# Kernel
PREFERRED_PROVIDER_virtual/kernel = "linux-rockchip"
KERNEL_IMAGETYPE = "fitImage"

# U-Boot
PREFERRED_PROVIDER_virtual/bootloader = "u-boot-rockchip"
PREFERRED_PROVIDER_u-boot = "u-boot-rockchip"
UBOOT_MACHINE = "cobra_defconfig"

# Architecture
DEFAULTTUNE = "aarch64"
TARGET_ARCH = "aarch64"

# Features
MACHINE_FEATURES = "alsa bluetooth usbhost usbgadget screen wifi"

# Image types
IMAGE_FSTYPES = "ext4 squashfs"

# Serial console
SERIAL_CONSOLE = "115200 ttyS2"

# Graphics
PREFERRED_PROVIDER_virtual/egl = "mali-userland"
PREFERRED_PROVIDER_virtual/libgles1 = "mali-userland"
PREFERRED_PROVIDER_virtual/libgles2 = "mali-userland"
PREFERRED_PROVIDER_virtual/libopencl = "mali-userland"

# Extra packages
MACHINE_ESSENTIAL_EXTRA_RDEPENDS += " \
    kernel-modules \
    kernel-devicetree \
"
```
